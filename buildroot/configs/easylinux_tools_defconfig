## buildroot/configs/easylinux_tools_defconfig
```kconfig
BR2_arm=y
BR2_arm920t=y
BR2_TOOLCHAIN_BUILDROOT_VENDOR="easylinux"
BR2_TOOLCHAIN_BUILDROOT_INET_IPV6=y
BR2_TOOLCHAIN_BUILDROOT_INET_RPC=y
BR2_TOOLCHAIN_BUILDROOT_WCHAR=y
BR2_PTHREAD_DEBUG=y
BR2_TOOLCHAIN_BUILDROOT_CXX=y
BR2_TARGET_GENERIC_HOSTNAME="easylinux"
BR2_TARGET_GENERIC_ISSUE="Welcome to easylinux"
```

## buildroot/configs/gt2440_defconfig
```kconfig
BR2_arm=y
BR2_arm920t=y
BR2_TOOLCHAIN_EXTERNAL=y
BR2_TOOLCHAIN_EXTERNAL_CUSTOM=y
BR2_TOOLCHAIN_EXTERNAL_PATH="$(TOPDIR)/ext/arm9/usr"
BR2_TOOLCHAIN_EXTERNAL_HEADERS_3_18=y
BR2_TOOLCHAIN_EXTERNAL_INET_IPV6=y
BR2_TOOLCHAIN_EXTERNAL_WCHAR=y
BR2_TOOLCHAIN_EXTERNAL_INET_RPC=y
BR2_TOOLCHAIN_EXTERNAL_CXX=y
BR2_TARGET_GENERIC_HOSTNAME="easylinux"
BR2_TARGET_GENERIC_ISSUE="Welcome to easylinux"
BR2_ROOTFS_DEVICE_TABLE="board/$(BR2_EASYLINUX_VENDOR)/common/device_table.txt"
BR2_ROOTFS_SKELETON_CUSTOM=y
BR2_ROOTFS_SKELETON_CUSTOM_PATH="board/$(BR2_EASYLINUX_VENDOR)/common/skeleton"
BR2_LINUX_KERNEL=y
BR2_LINUX_KERNEL_CUSTOM_LOCAL=y
BR2_LINUX_KERNEL_CUSTOM_LOCAL_PATH="$(TOPDIR)/../kernel/linux-3.18.6"
BR2_LINUX_KERNEL_USE_CUSTOM_CONFIG=y
BR2_LINUX_KERNEL_CUSTOM_CONFIG_FILE="$(BR2_BOARD_COMMON_DIR)/linux.config"
BR2_LINUX_KERNEL_IMAGE_TARGET_CUSTOM=y
BR2_LINUX_KERNEL_IMAGE_TARGET_NAME="Image"
BR2_EASYLINUX_CFLAGS="-Werror -fno-omit-frame-pointer -D_LITTLE_EDIAN=0x1234 -D_BIG_EDIAN=0x3412 -DBYTE_ORDER=0x1234 -D_MIPS_=2 -D_ARM_=1 -DCPU_ARCH=1"
BR2_EASYLINUX_PROCMGR=y
BR2_EASYLINUX_CORE=y
BR2_EASYLINUX_DEMODRIVER=y
BR2_EASYLINUX_PLATFORM=y
BR2_EASYLINUX_DEMO=y
BR2_PACKAGE_BUSYBOX_CONFIG="$(BR2_BOARD_COMMON_DIR)/busybox.config"
BR2_TARGET_ROOTFS_INITRAMFS=y
BR2_TARGET_ROOTFS_JFFS2=y
BR2_TARGET_ROOTFS_JFFS2_NANDFLASH_2K_128K=y
BR2_TARGET_UBOOT=y
BR2_TARGET_UBOOT_BOARDNAME="smdk2410"
BR2_PACKAGE_HOST_UBOOT_TOOLS=y
```

## buildroot/easylinux/Config.in
```kconfig
menu "EasyLinux Configuration"
config BR2_EASYLINUX_PROJECT_NAME
	string "project name"
	default "gt2440"

config BR2_EASYLINUX_CFLAGS
	string "easylinux app build cflags"
	default "-Werror -D_LITTLE_EDIAN=0x1234 -D_BIG_EDIAN=0x3412 -DBYTE_ORDER=0x1234"
	
config BR2_EASYLINUX_SDK_DIR
	string "sdk source dir"
	default "$(TOP_DIR)/../sdk"
	
config BR2_EASYLINUX_VENDOR
	string "board vendor name"
	default "samsung"
	
config BR2_EASYLINUX_BOARD_NAME
	string "board name"
	default "helix"

	source "easylinux/procmgr/Config.in"
	source "easylinux/core/Config.in"
	source "easylinux/demodriver/Config.in"
	source "easylinux/platform/Config.in"
	source "easylinux/demo/Config.in"
endmenu
```
